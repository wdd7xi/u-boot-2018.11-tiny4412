## u-boot-2018.11/board/samsung/wdong4412/Kconfig
```kconfig
if TARGET_WDONG4412

config SYS_BOARD
	default "wdong4412"

config SYS_VENDOR
	default "samsung"

config SYS_CONFIG_NAME
	default "wdong4412"

endif
```
